## boards/arm/cerberus/Kconfig.board
```kconfig
# Copyright (c) 2024 Andrew Kannan
# SPDX-License-Identifier: MIT

config BOARD_CERBERUS
    bool "cerberus"
    depends on SOC_NRF52840_QIAA
```

## boards/arm/minimi40/Kconfig
```kconfig
# Copyright (c) 2024 CannonKeys LLC
# SPDX-License-Identifier: MIT

config BOARD_ENABLE_DCDC
    bool "Enable DCDC mode"
    select SOC_DCDC_NRF52X
    default y
    depends on BOARD_MINIMI40

config LED
    default y
```

## boards/arm/minimi40/Kconfig.board
```kconfig
# Copyright (c) 2024 CannonKeys LLC
# SPDX-License-Identifier: MIT

config BOARD_MINIMI40
    bool "minimi40"
    depends on SOC_NRF52840_QIAA
```

## boards/arm/minimi40/Kconfig.defconfig
```kconfig
# Copyright (c) 2024 CannonKeys LLC
# SPDX-License-Identifier: MIT

if BOARD_MINIMI40

config ZMK_KEYBOARD_NAME
    default "Minimi40_W"

if USB_DEVICE_STACK

config USB_NRFX
    default y

endif # USB_DEVICE_STACK

config BT_CTLR
    default BT

config ZMK_BLE
    default y

config ZMK_USB
    default y

endif # BOARD_MINIMI40
```

## boards/arm/photon/Kconfig.board
```kconfig
# Copyright (c) 2024 CannonKeys LLC
# SPDX-License-Identifier: MIT

config BOARD_PHOTON
    bool "photon"
    depends on SOC_NRF52840_QIAA
```

## boards/arm/photon/Kconfig.defconfig
```kconfig
# Copyright (c) 2024 CannonKeys LLC
# SPDX-License-Identifier: MIT

if BOARD_PHOTON

config ZMK_KEYBOARD_NAME
    default "Photon"

if USB_DEVICE_STACK

config USB_NRFX
    default y

endif # USB_DEVICE_STACK

config BT_CTLR
    default BT

config ZMK_BLE
    default y

config ZMK_USB
    default y

endif # BOARD_PHOTON
```

## boards/arm/vida/Kconfig.board
```kconfig
# Copyright (c) 2024 Andrew Kannan
# SPDX-License-Identifier: MIT

config BOARD_VIDA
    bool "vida"
    depends on SOC_NRF52840_QIAA
```

## boards/arm/vida/Kconfig.defconfig
```kconfig
# Copyright (c) 2024 Andrew Kannan
# SPDX-License-Identifier: MIT

if BOARD_VIDA

config ZMK_KEYBOARD_NAME
    default "Vida"

if USB_DEVICE_STACK

config USB_NRFX
    default y

endif # USB_DEVICE_STACK

config BT_CTLR
    default BT

config ZMK_BLE
    default y

config ZMK_USB
    default y

endif # BOARD_VIDA
```

## config/west.yml
```yaml
manifest:
  remotes:
    - name: zmkfirmware
      url-base: https://github.com/zmkfirmware
    - name: awkannan
      url-base: https://github.com/awkannan
  projects:
    - name: zmk
      remote: zmkfirmware
      revision: main
      import: app/west.yml
    - name: zmk-behavior-gpio
      remote: awkannan
      revision: main
  self:
    path: config
```
